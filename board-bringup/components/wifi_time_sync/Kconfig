## board-bringup/components/wifi_time_sync/Kconfig
```kconfig
menu "联网校时配置"

config BOARD_WIFI_SSID
    string "Wi-Fi SSID"
    default ""
    help
        用于联网校时的 Wi-Fi 名称。留空时将跳过联网与 NTP。

config BOARD_WIFI_PASSWORD
    string "Wi-Fi 密码"
    default ""
    help
        用于联网校时的 Wi-Fi 密码。若网络无密码，可保持为空。

config BOARD_WIFI_MAXIMUM_RETRY
    int "Wi-Fi 最大重试次数"
    range 1 20
    default 8
    help
        连接失败后的最大重试次数。

config BOARD_NTP_SERVER
    string "NTP 服务器"
    default "ntp.aliyun.com"
    help
        首选 NTP 时间服务器。

config BOARD_TIMEZONE
    string "设备时区"
    default "CST-8"
    help
        设备本地时区，默认中国标准时间。

endmenu
```

## board-bringup/sdkconfig.defaults
```kconfig
CONFIG_IDF_TARGET="esp32s3"
CONFIG_ESP_CONSOLE_USB_SERIAL_JTAG=y
CONFIG_ESP_MAIN_TASK_STACK_SIZE=8192
CONFIG_ESPTOOLPY_FLASHSIZE_16MB=y
CONFIG_PARTITION_TABLE_SINGLE_APP_LARGE=y
CONFIG_BOARD_WIFI_SSID=""
CONFIG_BOARD_WIFI_PASSWORD=""
CONFIG_BOARD_WIFI_MAXIMUM_RETRY=8
CONFIG_BOARD_NTP_SERVER="ntp.aliyun.com"
CONFIG_BOARD_TIMEZONE="CST-8"
CONFIG_ESPTOOLPY_FLASHSIZE="16MB"
CONFIG_SPIRAM=y
CONFIG_SPIRAM_MODE_OCT=y
CONFIG_SPIRAM_SPEED_80M=y
CONFIG_SPIRAM_BOOT_INIT=y
CONFIG_SPIRAM_USE_MALLOC=y
CONFIG_SPIRAM_MEMTEST=y
CONFIG_SPIRAM_MALLOC_ALWAYSINTERNAL=16384
CONFIG_SPIRAM_MALLOC_RESERVE_INTERNAL=32768
CONFIG_LV_CONF_SKIP=y
# CONFIG_LV_BUILD_EXAMPLES is not set
CONFIG_LV_FONT_MONTSERRAT_14=y
CONFIG_LV_FONT_MONTSERRAT_16=y
CONFIG_LV_FONT_MONTSERRAT_22=y
CONFIG_LV_FONT_MONTSERRAT_24=y
CONFIG_LV_FONT_MONTSERRAT_48=y
CONFIG_USB_SERIAL_JTAG_SUPPORT_LIGHT_SLEEP=y
```
